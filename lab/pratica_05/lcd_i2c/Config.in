## lab/pratica_05/lcd_i2c/Config.in
```kconfig
config BR2_PACKAGE_LCD_I2C
    bool "lcd_i2c"
    help
      Programa simples de execucao de lcd i2c.
```

## lab/pratica_05/led_blink_sequence/Config.in
```kconfig
config BR2_PACKAGE_LED_BLINK_SEQUENCE
    bool "led_blink_sequence"
    help
      Programa simples para piscar LEDS usando GPIO num 
      sequencia de 10 vezes consecultivas.
```

## lab/pratica_05/pwm_buzzer/Config.in
```kconfig
config BR2_PACKAGE_PWM_BUZZER
    bool "pwm_buzzer"
    help
      Programa simples para tocar buzzer com pwm.
```

## lab/pratica_05/pwm_buzzer2/Config.in
```kconfig
config BR2_PACKAGE_PWM_BUZZER2
    bool "pwm_buzzer2"
    help
      Programa simples para tocar musica no buzzer com pwm.
```

## lab/pratica_05/pwm_led/Config.in
```kconfig
config BR2_PACKAGE_PWM_LED
    bool "pwm_led"
    help
      Programa simples de execucao do led via pwm.
```

## lab/pratica_05/pwm_servo/Config.in
```kconfig
config BR2_PACKAGE_PWM_SERVO
    bool "pwm_servo"
    help
      Programa simples de execucao do servo motor via pwm.
```

## lab/projeto/projeto_ofc/Config.in
```kconfig
config BR2_PACKAGE_PROJETO_OFC
    bool "projeto_ofc"
    help
      Programa simples mover o portão.
```
